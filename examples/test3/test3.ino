#include "I2CCom.h"
I2CCom_Master I2CCom(&Wire1);
#include "GraphicsCardI2CCom.h"
GraphicsCardI2CCom gI2C(&I2CCom);

uint8_t testimg[] = {0x1, 0xFF, 0x0, 0x27, 0x0, 0x13, 0xFB, 0x0, 0x28, 0x0, 0x13, 0xF6, 0x0,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 0x0, 0x63};
//uint8_t testimg[] = {0x00, 0x01, 0x02, 0x03};

uint32_t crc_testimg = 0;

void setup() {
  // put your setup code here, to run once:
  I2CCom.OnDeviceConnected = OnConnected;
  I2CCom.OnDeviceDisconnected = OnDisconnected;
  I2CCom.begin();
  I2CCom.Ignore(0x27);
  Serial.begin(57600);
  crc_testimg = crc32(testimg, sizeof(testimg));
}

bool q_enabled = true;
void loop() {
  // put your main code here, to run repeatedly:
  char r = Serial.read();
  if (r == 'q') {
    if (Serial.read() == 'e') {
      q_enabled = !q_enabled;
      return;
    }
    if (Serial.read() == 'o') {
      Smart();
    }
  }
  if (r == 'i') {
    Serial.println("Enter I2C: ");
    byte buffer[128];
    int length = 0;
    while (true) {
      String read = Serial.readStringUntil(' ');
      int _int = read.toInt();
      if (_int < 0 || _int > 255) {
        break;
      }
      buffer[length] = _int;
      length++;
    }
    Serial.println(length);
    Serial.println(gI2C.SendRawCmd(buffer, length));
  }
  if (q_enabled) {
    Smart();
  }
  I2CCom.ScanDevices();
  delay(50);
}

void OnConnected(int address) {
  Serial.print("Connected: ");
  Serial.println(address);
}

void OnDisconnected(int address) {
  Serial.print("Disconnected: ");
  Serial.println(address);
}

void Reload() {
  gI2C.Objects_Create(0, 5);
  gI2C.Objects_BlobAsset(0, 1);
  gI2C.Objects_Resize(0, 0, 100, 100);
}

void Init() {
  gI2C.InitIfNot();
  gI2C.WriteAssetOrCRC(1, testimg, sizeof(testimg));
  Reload();
}

void Smart() {
  Init();
}

uint32_t crc32(const uint8_t *s, size_t n) {
  uint32_t crc = 0xFFFFFFFF;

  for (size_t i = 0; i < n; i++) {
    char ch = s[i];
    for (size_t j = 0; j < 8; j++) {
      uint32_t b = (ch ^ crc) & 1;
      crc >>= 1;
      if (b) crc = crc ^ 0xEDB88320;
      ch >>= 1;
    }
  }

  return ~crc;
}
